## components/c6_adxl345/Kconfig
```kconfig
menu "c6_adxl345 (3-axis accelerometer, SPI)"

    config C6_ADXL345_ENABLE
        bool "Enable ADXL345 accelerometer sampling"
        default y
        help
            Local (C6-side) bench sensor, exposed only through /api/diag - it
            never enters the v2/SF protocol (safety arbitration stays on the
            TC275).  When the chip does not answer, start() logs one warning
            and the diag field reports "imu":null; boot continues normally.

    config C6_ADXL345_SCLK_GPIO
        int "SCLK GPIO"
        default 10
        range 0 23
        help
            Bit-banged SPI bus (the single C6 GPSPI is owned by the TC275
            LINK slave).  Keep every bus pin away from: 4/5/8/9/15
            (strapping), 12/13 (USB D-/D+), 16/17 (UART0 console),
            18/19/20/21/23 (LINK SPI), 8 (WS2812).

    config C6_ADXL345_MOSI_GPIO
        int "MOSI GPIO"
        default 11
        range 0 23

    config C6_ADXL345_MISO_GPIO
        int "MISO GPIO"
        default 6
        range 0 23
        help
            GPIO6 sits next to CS(7)/SCLK(10)/MOSI(11) on the DevKitC-1 J1
            header; GPIO14 is not brought out on the headers.

    config C6_ADXL345_CS_GPIO
        int "CS GPIO (manual, active low)"
        default 7
        range 0 23

    config C6_ADXL345_HALF_BIT_US
        int "SCLK half-bit period, us"
        default 1
        range 1 100
        help
            1 us -> ~500 kHz SCLK; the ADXL345 accepts up to 5 MHz but the
            diag sampling does not need it, and a soft clock keeps the CPU
            cost trivial (~0.1 ms per 6-byte read at 50 Hz).

    config C6_ADXL345_RANGE_G
        int "Measurement range, g (2/4/8/16, full-resolution mode)"
        default 16
        range 2 16
        help
            Full-resolution mode keeps 3.9 mg/LSB at any range; the range only
            sets the clipping ceiling.  16g covers car-level impacts and
            vibration without saturating; drop to 2g for a tilt-only bench.

    config C6_ADXL345_ODR_HZ
        int "Output data rate, Hz (12.5/25/50/100/200/400/800/1600)"
        default 100
        range 12 1600
        help
            Nearest supported rate is programmed into BW_RATE.

    config C6_ADXL345_POLL_MS
        int "Sample poll period, ms"
        default 20
        range 5 1000
        help
            20 ms (50 Hz) is plenty for the diag view and keeps the polling
            task negligible.

endmenu
```

## components/c6_led/Kconfig
```kconfig
menu "c6_led (WS2812 status indicator)"

    config C6_LED_ENABLE
        bool "Enable WS2812 status LED patterns"
        default y
        help
            One addressable RGB LED (WS2812) driven by RMT on a single GPIO.
            The app state machine maps transitions onto patterns: boot=white
            slow blink, factory_wait=yellow double-blink, net_start=blue 2 Hz,
            online=green heartbeat (normal operation), net failure=red 4 Hz.

    config C6_LED_GPIO
        int "WS2812 data GPIO"
        default 8
        range 0 30
        help
            ESP32-C6-DevKitC-1 wires the onboard WS2812 to GPIO8.  GPIO8 is a
            strapping pin (sampled at reset); driving it after boot is safe.

endmenu
```

## components/c6_link/Kconfig
```kconfig
menu "C6 LINK (SPI slave to TC275, myCar doc 22)"

    config C6_LINK_SPI_SCLK_GPIO
        int "LINK SPI SCLK GPIO (from TC275 P33.11)"
        default 19
        help
            Wiring is the single source of truth: myCar 23-wiring.md §9.1
            (X1-3 P33.11 SCLK -> J3-9 GPIO19).

    config C6_LINK_SPI_MOSI_GPIO
        int "LINK SPI MOSI GPIO (from TC275 P33.12)"
        default 18
        help
            23-wiring.md §9.1: X1-4 P33.12 MTSR -> J3-10 GPIO18.

    config C6_LINK_SPI_MISO_GPIO
        int "LINK SPI MISO GPIO (to TC275 P33.13)"
        default 20
        help
            23-wiring.md §9.1: X1-5 P33.13 MRST <- J3-8 GPIO20.

    config C6_LINK_SPI_CS_GPIO
        int "LINK SPI CS GPIO (from TC275 P23.4 SLSO5)"
        default 23
        help
            23-wiring.md §9.1: X1-12 P23.4 SLSO5 -> J3-5 GPIO23.

    config C6_LINK_SPI_IRQ_GPIO
        int "LINK data-ready IRQ GPIO (open-drain, to TC275 P23.0)"
        default 21
        help
            23-wiring.md §9.1: J3-7 GPIO21 -> X1-8 P23.0 (IOM edge IRQ).
            Open-drain; the 10k pull-up to 3V3 is external hardware
            (22 §3.2 - without it the link degrades to pure polling).

    config C6_LINK_SPI_CLOCK_HZ
        int "Production clock step (master-driven, diag mirror)"
        default 5000000
        range 1000000 20000000
        help
            The master owns the clock; this value is what the slave reports
            in diagnostics and what the TC275 side should be configured to.
            Ladder per 22 §8 G5: 1/2/5/10/20 MHz, production baseline 5 MHz.

    config C6_LINK_DEBUG_UART_RX_GPIO
        int "Debug console RX GPIO (documentation anchor)"
        default 6
        help
            23-wiring.md §2: GPIO6/7 are the debug console (J1-5/6) - the
            UART is NOT used by the LINK anymore (T3: former TX=10/RX=11
            defaults were wrong and are deleted).  Kept here so that
            documentation, Kconfig and hardware agree.

    config C6_LINK_DEBUG_UART_TX_GPIO
        int "Debug console TX GPIO (documentation anchor)"
        default 7

endmenu
```

## main/Kconfig.projbuild
```kconfig
menu "esp32c6_car project"

    config C6_FACTORY_DEV_OVERRIDE
        bool "BENCH ONLY: synthesize factory data when NVS is empty"
        default y
        help
            Lets a bench board come up as SD-DEV000 with a fixed password when
            no production provisioning was written.  MUST be disabled (n) for
            production builds (LLDD 4.1 FACTORY_WAIT semantics).

    config C6_MAINT_BLE
        bool "Enable BLE DPT maintenance channel (NimBLE)"
        default n
        help
            LLDD 4.9: NimBLE GATT service for the production fixture.
            Requires CONFIG_BT_ENABLED=y (build with sdkconfig.maint or set
            it manually).  Consumer builds keep this off (open question Q3).

    config C6_BENCH_BOD_DISABLE
        bool "BENCH ONLY: disable brownout detector (weak bench supply)"
        default n
        help
            Brownout fires at Wi-Fi power-up (~400 ms, RF calibration current
            peak) when the bench supply sags below 2.51 V - the LOWEST
            threshold level available on ESP32-C6 (SEL_7), so there is no
            softer step.  This option calls esp_brownout_disable() at the
            earliest point of app_main.  Risk: flash writes and RF calibration
            run outside the guaranteed voltage window - bench bring-up only,
            NEVER for production builds, and fix the supply first if possible.

    config C6_BENCH_CTRL
        bool "BENCH ONLY: control bypass (no pairing, DRIVE->SET_SPEED, C6 heartbeat)"
        default n
        help
            Bench bring-up shortcut while the TC275 build still refuses 0x50
            DRIVE and the PAIR channel (tc275_car link_dispatch whitelist).  With
            this on:  every WS session is promoted to CTRL without a token;
            v2 DRIVE (0x50 v,omega) is translated on the C6 into SET_SPEED
            (0x10 left,right percent), the one op CPU0 already executes; and
            the bridge injects a 0x21 HEARTBEAT every 60 ms so CPU0's 100 ms
            heartbeat watchdog stays fed.  MUST be disabled (n) for production
            builds - it removes the pairing gate and changes the wire op.

    config C6_NET_START_DELAY_MS
        int "Delay before Wi-Fi start (voltage settling, ms)"
        default 0
        range 0 5000
        help
            Bench mitigation: let the supply recover from the boot surge
            before the RF power-up peak.  0 = no delay (production default).

    config C6_WIFI_TX_POWER_QDBM
        int "Max Wi-Fi TX power, 0.25 dBm units (0 = chip default)"
        default 0
        range 0 84
        help
            Bench mitigation for weak supplies: caps the transmit power and
            with it the PA current peak (e.g. 40 = 10 dBm).  0 keeps the
            chip default (~20 dBm) - production stays 0.

    config C6_LEGACY_TCP
        bool "Enable TCP 8080 legacy raw-frame bridge"
        default n
        help
            LLDD FR-10: proto v2 frames over TCP 8080 for demo clients.
            Recommended only for the first production batches (Q4).

    config C6_CAPTIVE_PORTAL
        bool "Auto-popup captive portal (wildcard DNS + probe redirect)"
        default n
        help
            When enabled (y): the wildcard captive DNS hijacks every A query to
            the AP IP and the HTTP wildcard handler 302-redirects the phone's
            connectivity probes to "/", so iOS/Android auto-pop the control
            page in a captive-portal webview.

            When disabled (n, default): no DNS hijack, and the connectivity
            probes are answered as SUCCESS (iOS "Success" page / Android 204)
            so the phone reports the network as online and does NOT pop a
            window.  The user opens the page manually by typing the address
            (http://192.168.4.1/ or http://mycar.local/ via mDNS).

    config C6_OTA_NO_AUTH
        bool "OTA endpoints without pair token (bench/dev)"
        default y
        help
            When enabled (y): POST /ota/c6 and /ota/tc275 skip the control
            token check, so fw.py / bench tools push firmware without the
            button-window pairing dance.  Safe for the bench because every
            bundle is still ed25519-verified on-target before any flash
            write; unauthenticated pushes can only be rejected garbage.

            Production MUST set this to n: the token gate is what keeps an
            unauthenticated WLAN peer from queuing images at will.

endmenu
```
